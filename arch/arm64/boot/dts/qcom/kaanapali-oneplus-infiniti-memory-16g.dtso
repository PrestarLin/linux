// SPDX-License-Identifier: GPL-2.0
/*
 * Memory-map overlay -- 16G machine, from the stock firmware dump of the
 * actual unit (android-file/fdt.dtb, archived decompiled as tmp/stock-16g.dts
 * in the oneplus15-linux project).  21 regions / 84 cells.
 *
 * On a 16G unit the 12G-machine map (kaanapali-oneplus-infiniti-memory-12g)
 * describes regions past the end of RAM or inside holes (~30MB of ghost
 * pages: 0x880000000 over by 2M, 0x8b0000000 over by 28M); handing one of
 * those to the page allocator ends in a synchronous external abort
 * (garbled screen, init killed).  Boot a unit with the map matching its
 * RAM: choose exactly one memory overlay, never both.
 */
/dts-v1/;
/plugin/;

/ {
	#address-cells = <2>;
	#size-cells = <2>;

	fragment@0 {
		target-path = "/memory@a0000000";
		__overlay__ {
			reg = <
				       0x00000000 0x81960000 0x00000000 0x000a0000 0x00000000 0x81a60000 0x00000000 0x001a0000 0x00000000 0x81cf4000 0x00000000 0x0000c000
				       0x00000000 0x82478000 0x00000000 0x00028000 0x00000000 0xc4800000 0x00000000 0x13000000 0x00000000 0xd79c0000 0x00000000 0x00040000
				       0x00000000 0xd7c00000 0x00000000 0x00400000 0x00000000 0xd8800000 0x00000000 0x00000000 0x00000000 0xe34a0000 0x00000000 0x1c360000
				       0x00000008 0x80000000 0x00000000 0x2f6fd000 0x00000008 0xb0000000 0x00000000 0x06500000 0x0000000a 0x00000000 0x00000002 0x00000000
				       0x00000008 0xc0000000 0x00000001 0x40000000 0x00000000 0x82600000 0x00000000 0x00100000 0x00000000 0x82800000 0x00000000 0x02200000
				       0x00000000 0x8a980000 0x00000000 0x00080000 0x00000000 0x9959c000 0x00000000 0x00064000 0x00000000 0x9ce80000 0x00000000 0x02e00000
				       0x00000000 0x9ffe0000 0x00000000 0x00070000 0x00000000 0xa0910000 0x00000000 0x00a70000 0x00000000 0xa6400000 0x00000000 0x1d9d0000
			>;
		};
	};
};
