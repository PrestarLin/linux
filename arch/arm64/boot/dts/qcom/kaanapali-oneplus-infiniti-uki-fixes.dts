// SPDX-License-Identifier: GPL-2.0
/*
 * Packaging-time overlay for UKIs booted through the EFI stub.
 *
 * The ABL/Android load path fixes up placeholder nodes at boot; the EFI
 * stub does not, so a UKI embedding the source dtb boots with:
 *
 * - no ramoops region -> no pstore console after a failed boot.  Re-add
 *   the 4M region the ABL path reserves at 0xb8000000 so dmesg survives
 *   a reboot for diagnosis.
 *
 * The memory map deliberately lives elsewhere, in the choose-one overlays
 *   kaanapali-oneplus-infiniti-memory-12g.dtbo   12G-machine map
 *   kaanapali-oneplus-infiniti-memory-16g.dtbo   16G stock dump
 * applied per machine by the packaging loop.  One map here would overwrite
 * the other's: a 12G capture read on a 16G unit maps ~30MB of ghost pages
 * (regions past the end of RAM or inside holes) and handing those to the
 * page allocator ends in a synchronous external abort.
 */
/dts-v1/;
/plugin/;

/ {
	#address-cells = <2>;
	#size-cells = <2>;

	fragment@0 {
		target-path = "/reserved-memory";
		__overlay__ {
			ramoops@b8000000 {
				compatible = "ramoops";
				reg = <0x00 0xb8000000 0x00 0x00400000>;
				record-size = <0x00040000>;
				console-size = <0x00200000>;
			};
		};
	};
};
